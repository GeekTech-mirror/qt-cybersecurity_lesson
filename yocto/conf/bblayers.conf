## yocto/conf/bblayers.conf
```bitbake
# POKY_BBLAYERS_CONF_VERSION is increased each time build/conf/bblayers.conf
# changes incompatibly
POKY_BBLAYERS_CONF_VERSION = "2"

BBPATH = "${TOPDIR}"
BBFILES ?= ""

BBLAYERS ?= " \
  /Drive/.git_repo/yocto/poky/meta \
  /Drive/.git_repo/yocto/poky/meta-poky \
  /Drive/.git_repo/yocto/poky/meta-openembedded/meta-oe \
  /Drive/.git_repo/yocto/poky/meta-raspberrypi \
  /Drive/.git_repo/yocto/poky/meta-qt6 \
  /Drive/.git_repo/yocto/poky/meta-cybercraft \
  "
```
